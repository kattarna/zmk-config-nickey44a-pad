## boards/shields/nickey44a/Kconfig.shield
```kconfig
config SHIELD_NICKEY44A_R
    def_bool $(shields_list_contains,nickey44a_r)

config SHIELD_NICKEY44A_L
    def_bool $(shields_list_contains,nickey44a_l)

config ZMK_BEHAVIOR_F13_GESTURE_GATE
    bool "Enable F13 hold gesture gate and layer up behaviors"
    default y
```

## boards/shields/nickey44a/dts/bindings/behaviors/zmk,behavior-f13-hold.yaml
```yaml
description: F13 hold key behavior that sets gesture gate flag
compatible: "zmk,behavior-f13-hold"
include: zero_param.yaml
```

## boards/shields/nickey44a/dts/bindings/input/processor/behaviors/zmk,behavior-layer-up.yaml
```yaml
description: Increment active base layer up to layer 9
compatible: "zmk,behavior-layer-up"
include: zero_param.yaml
```

## boards/shields/nickey44a/dts/bindings/input/processor/zmk,input-processor-f13-gate.yaml
```yaml
description: Gate input events based on F13 hold state
compatible: "zmk,input-processor-f13-gate"
include: ip_zero_param.yaml
properties:
  mode:
    type: int
    required: true
```

## boards/shields/nickey44a/dts/bindings/input/processor/zmk,input-processor-f13-layer-gesture.yaml
```yaml
description: 4-way swipe and tap layer switcher when F13 is held
compatible: "zmk,input-processor-f13-layer-gesture"
include: ip_zero_param.yaml
properties:
  hwheel-code:
    type: int
    required: true
  wheel-code:
    type: int
    required: true
  touch-code:
    type: int
    required: true
  threshold:
    type: int
    default: 8
  axis-ratio:
    type: int
    default: 2
```
